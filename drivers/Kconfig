## drivers/max17048/Kconfig
```kconfig
config MAX17048
    bool "MAX17048 Fuel Gauge"
	default y
	select I2C

config MAX17048_LOG_LEVEL
    int
    default 4
```

## drivers/max17048/dts/bindings/maxim,max17048.yaml
```yaml
description: Maxim MAX17048 battery fuel gauge sensor

compatible: "maxim,max17048"

include: i2c-device.yaml

properties:
  interrupt-gpios:
    type: phandle-array
    required: false
    description: |
      (Optional) Interrupt on alarm signal.
```

## drivers/px1122r/dts/bindings/skytraq,px1122r.yaml
```yaml
description: SkyTraq PX1122R RTK GNSS module

compatible: "skytraq,px1122r"

include: uart-device.yaml

properties:
  onepps-gpios:
    type: phandle-array
    required: false
    description: |
      (Optional) One pulse-per-second output.
```

## drivers/px1122r/zephyr/Kconfig
```kconfig
config PX1122R_DRIVER
    bool "Enable the SkyTraq PX1122R driver"

config PX1122R_LOG_LEVEL
    int
    default 4
```

## drivers/rfm9x/Kconfig
```kconfig
config RFM9x
    bool "RFM9x LoRa"
	default y
	select SPI

config RFM9x_LOG_LEVEL
    int
    default 4
```

## drivers/rfm9x/dts/bindings/hoperf,rfm9x.yaml
```yaml
description: HopeRF RFM9x LoRa module

compatible: "hoperf,rfm9x"

include: spi-device.yaml

properties:
  en-gpios:
    type: phandle-array
    required: false
    description: |
      (Optional) Enable pin.

  rst-gpios:
    type: phandle-array
    required: false
    description: |
      (Optional) Reset pin.
```
